## Documentation/devicetree/bindings/serial/mtk-btif.txt
```
Device-Tree bindings for MediaTek BTIF controller found on those
MediaTek SoCs with Bluetooth feature

Required properties:
- compatible: Should be one of:
	- "mediatek,mt7622-btif" : for MT7622 SoC
	- "mediatek,mt7623-btif" : for MT7623 SoC
- reg: The base address of the BTIF register bank;
- interrupts: A single interrupt specifier;
- clocks: list of clock specifiers, corresponding to
	  entries in clock-names property;
- clock-names: should contain "main" entries.

Optional properties:
- mediatek,loopback: Boolean; if defined, indicates that BTIF controller
	running on the loopback mode.

Example:

	btif: btif@1100c000 {
		compatible = "mediatek,mt7623-btif";
		reg = <0 0x1100c000 0 0x1000>;
		interrupts = <GIC_SPI 50 IRQ_TYPE_LEVEL_LOW>;
		clocks = <&pericfg CLK_PERI_BTIF>;
		clock-names = "main";
	};
```

## Documentation/devicetree/bindings/soc/mediatek/gce.txt
```
MediaTek GCE
===============

The Global Command Engine (GCE) is used to help read/write registers with
critical time limitation, such as updating display configuration during the
vblank. The GCE can be used to implement the Command Queue (CMDQ) driver.
Currently, the GCE only supports display related hardwares, but we expect
it can be extended to other hardwares for future requirements.

Required properties:
- compatible: Must be "mediatek,mt8173-gce"
- reg: Address range of the GCE unit
- interrupts: The interrupt signal from the GCE block
- clock: Clocks according to the common clock binding
- clock-names: Must be "gce" to stand for GCE clock

Example:

	gce: gce@10212000 {
		compatible = "mediatek,mt8173-gce";
		reg = <0 0x10212000 0 0x1000>;
		interrupts = <GIC_SPI 135 IRQ_TYPE_LEVEL_LOW>;
		clocks = <&infracfg CLK_INFRA_GCE>;
		clock-names = "gce";
	};

	mmsys: clock-controller@14000000 {
		compatible = "mediatek,mt8173-mmsys", "syscon";
		reg = <0 0x14000000 0 0x1000>;
		power-domains = <&scpsys MT8173_POWER_DOMAIN_MM>;
		#clock-cells = <1>;
		mediatek,gce = <&gce>;
	};
```

## Documentation/devicetree/bindings/soc/mediatek/mediatek,smi-larb.txt
```
SMI(Smart Multimedia Interface) Local Arbiter

The hardware block diagram please check bindings/iommu/mediatek,iommu.txt

Required properties:
- compatible : must be "mediatek,mt8173-smi-larb"
- reg : the register and size of each local arbiter.
- smi : must be "&smi_common". Refer to bindings/soc/mediatek,smi.txt.
- clocks : must contain one entry for each clock-names.
	There are 2 clockes:
	APB clock : Advanced Peripheral Bus clock, It's the clock for setting
		the register.
	SMI clock : It's the clock for transfer data and command.
- clock-name: must be "apb" and "smi".

Example:
	larb0:larb@14021000 {
		compatible = "mediatek,mt8173-smi-larb";
		reg = <0 0x14021000 0 0x1000>;
		smi = <&smi_common>;
		clocks = <&mmsys MM_SMI_LARB0>,
			 <&mmsys MM_SMI_LARB0>;
		clock-names = "apb", "smi";
	};
```

## Documentation/devicetree/bindings/soc/mediatek/mediatek,smi.txt
```
SMI(Smart Multimedia Interface)

The hardware block diagram please check bindings/iommu/mediatek,iommu.txt

Required properties:
- compatible : must be "mediatek,mt8173-smi"
- reg : the register and size of the smi.
- clocks : must contain one entry for each clock-names.
	There are 2 clockes:
	APB clock : Advanced Peripheral Bus clock, It's the clock for setting
		the register.
	SMI clock : It's the clock for transfer data and command.
- clock-name: must be "apb" and "smi".

Example:
	smi_common:smi@14022000 {
		compatible = "mediatek,mt8173-smi";
		reg = <0 0x14022000 0 0x1000>;
		clocks = <&mmsys MM_SMI_COMMON>,
			 <&mmsys MM_SMI_COMMON>;
		clock-names = "apb", "smi";
	};
```

## Documentation/devicetree/bindings/soc/mediatek/usb-wakeup.txt
```
MediaTek USB Wakeup binding
-----------------------------

The SSUSB-SPM glue layer is used to control some signals of USB
wakeup, such as IP-SLEEP, LINE-STATE, IDDIG etc, which are mutually
exclusive.

Required properties (controller (parent) node):
- compatible: Should be one of:
	- "mediatek,<soc-model>-uwk","mediatek,usb-wk-v1"
		soc-model is the name of SoC, supports one of:
		- mt8173, mt8176
	- "mediatek,<soc-model>-uwk","mediatek,usb-wk-v2"
		soc-model is the name of SoC, supports one of:
		- mt2712

- mediatek,wkc: must contain a syscon phandle, such as pericfg controller
- #address-cells : should be '1'
- #size-cells : should be '1'

Required nodes: a sub-node is required for each glue layer provided for
	each SSUSB IP. Address range information including the usual 'reg'
	property is used inside these nodes to describe the controller's
	topology.

Required properties (glue layer (child) node):
- reg: address and length of the register set within the syscon which is
	assigned to @mediatek,wkc.
- #mediatek,uwk-cells: should be 1 (see the second example), cell after
	glue layer phandle is wakeup type from:
		- MTU_WK_IP_SLEEP
		- MTU_WK_LINE_STATE
	The wakeup types defined in
		- include/dt-bindings/soc/mediatek,usb-wakeup.h


Example:

usb_wakeup: uwk@0 {
	compatible = "mediatek,mt2712-uwk","mediatek,usb-wk-v2";
	mediatek,wkc = <&pericfg>;
	#address-cells = <1>;
	#size-cells = <1>;
	status = "okay";

	usb_wk0: uwk@510 {
		reg = <0x510 0x4>;
		#mediatek,uwk-cells = <1>;
		status = "okay";
	};

	usb_wk1: uwk@514 {
		reg = <0x514 0x4>;
		#mediatek,uwk-cells = <1>;
		status = "okay";
	};
};


Specifying wakeup control of devices
---------------------------------

Device nodes should specify the configuration required in their
"mediatek,uwks" property, containing a phandle to the glue layer
node and a wakeup type, because each USB controller has just one
glue layer for wakeup, so only one phandle is supported;

Example:

#include <dt-bindings/soc/mediatek,usb-wakeup.h>

usb_host1: xhci@112c0000 {
	...
	mediatek,uwks = <&usb_wk2 MTU_WK_IP_SLEEP>;
	...
};
```

## Documentation/devicetree/bindings/usb/mt65xx-u3phy.txt
```
MT65xx U3PHY

The device node for Mediatek SOC usb3.0 phy

Required properties:
 - compatible : Should be "mediatek,mt8173-u3phy"
 - reg        : Offset and length of registers, the first is for mac domain,
	another for phy domain
 - power-domains: to enable usb's mtcmos
 - reg-vusb33-supply:  regulator of usb avdd3.3v
 - clocks     : must support all clocks that phy need
 - clock-names: should be "wakeup_deb_p0", "wakeup_deb_p1" for wakeup
	debounce control clocks, "sys_mac" for sys and mac clocks and
	"u3phya_ref" for u3phya reference clock.

Optional properties:
 - disable-usb2-p1 : disable port1 of usb2.0 which has two ports.
 - reg-p1-vbus-supply : regulator of port1's vbus;

Example:

u3phy: usb-phy@11271000 {
	compatible = "mediatek,mt8173-u3phy";
	reg = <0 0x11271000 0 0x3000>,
	      <0 0x11280000 0 0x20000>;
	power-domains = <&scpsys MT8173_POWER_DOMAIN_USB>;
	reg-vusb33-supply = <&mt6397_usb_reg>;
	clocks = <&perisys PERI_USB0>,
		 <&perisys PERI_USB1>,
		 <&topckgen CLK_TOP_USB30_SEL>,
		 <&apmixedsys CLK_APMIXED_REF2USB_TX>;
	clock-names = "wakeup_deb_p0",
		      "wakeup_deb_p1",
		      "sys_mac",
		      "u3phya_ref";
	disable-usb2-p1;
};
```

## Documentation/devicetree/bindings/usb/mt8173-xhci.txt
```
MT65XX xhci

The device node for Mediatek SOC usb3.0 host controller

Required properties:
 - compatible : supports "mediatek,mt8173-xhci", "generic-xhci"
 - reg        : Offset and length of registers
 - interrupts : Interrupt; mode, number and trigger
 - usb-phy : the phy that xhci will bind
 - usb3-lpm-capable: suppots USB3 LPM

Example:
usb: usb30@11270000 {
	compatible = "mediatek,mt8173-xhci", "generic-xhci";
	reg = <0 0x11270000 0 0x1000>;
	interrupts = <GIC_SPI 115 IRQ_TYPE_LEVEL_LOW>;
	usb-phy = <&u3phy>;
	usb3-lpm-capable;
};
```

## Documentation/devicetree/bindings/video/bridge/ps8640.txt
```
ps8640-bridge bindings

Required properties:
	- compatible: "parade,ps8640"
	- reg: first i2c address of the bridge
	- power-gpios: OF device-tree gpio specification for power pin.
	- reset-gpios: OF device-tree gpio specification for reset pin.
	- mode-sel-gpios: OF device-tree gpio specification for mode-sel pin.
	- ps8640-1v2-supply: OF device-tree regulator specification for 1v2.
	- ps8640-3v3-supply: OF device-tree regulator specification for 3v3.

Optional properties:
	- video interfaces: Device node can contain video interface port
			    nodes for panel according to [1].

[1]: Documentation/devicetree/bindings/media/video-interfaces.txt

Example:
	edp-bridge@18 {
		compatible = "parade,ps8640";
		reg = <0x18>;
		power-gpios = <&pio 116 GPIO_ACTIVE_HIGH>;
		reset-gpios = <&pio 115 GPIO_ACTIVE_HIGH>;
		mode-sel-gpios = <&pio 92 GPIO_ACTIVE_HIGH>;
		ps8640-1v2-supply = <&ps8640_fixed_1v2>;
		ps8640-3v3-supply = <&mt6397_vgp2_reg>;

		ports {
			#address-cells = <1>;
			#size-cells = <0>;

			port@0 {
				reg = <0>;

				ps8640_in: endpoint {
					remote-endpoint = <&dsi0_out>;
				};
			};

			port@1 {
				reg = <1>;

				ps8640_out: endpoint {
					remote-endpoint = <&panel_in>;
				};
			};
		};
	};
```
