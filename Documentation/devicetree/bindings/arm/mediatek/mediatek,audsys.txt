## Documentation/devicetree/bindings/arm/mediatek/mediatek,audsys.txt
```
MediaTek AUDSYS controller
============================

The MediaTek AUDSYS controller provides various clocks to the system.

Required Properties:

- compatible: Should be one of:
	- "mediatek,mt2701-audsys",
	- "mediatek,mt7622-audsys",
- #clock-cells: Must be 1

The AUDSYS controller uses the common clk binding from
Documentation/devicetree/bindings/clock/clock-bindings.txt
The available clocks are defined in dt-bindings/clock/mt*-clk.h.

Must be a subnode of MediaTek audio subsystem device tree node.
See ../mfd/mtk-audsys.txt for details about the parent node.

Example:

	audio-subsystm@11220000 {
		compatible = "mediatek,mt2701-audsys-core";
		...
		audsys: clock {
			compatible = "mediatek,mt2701-audsys";
			#clock-cells = <1>;
		};
	};
```

## Documentation/devicetree/bindings/dma/mtk-hsdma.txt
```
Mediatek High-Speed DMA Controller
==================================

This driver follows the generic DMA bindings defined in dma/dma.txt.

Required properties:

- compatible:	Must be one of
		  "mediatek,mt7623-hsdma".
- reg:		Should contain the register's base address and length.
- interrupts:	Should contain a reference to the interrupt used by this
		device.
- clocks:	Should be the clock specifiers corresponding to the entry in
		clock-names property.
- clock-names:	Should contain "hsdma" entries.
- #dma-cells: 	The length of the DMA specifier, must be <1>. This one cell
		in dmas property of a client device represents the channel
		number.
Example:

        hsdma: hsdma@1b007000 {
		compatible = "mediatek,mt7623-hsdma";
		reg = <0 0x1b007000 0 0x1000>;
		interrupts = <GIC_SPI 98 IRQ_TYPE_LEVEL_LOW>;
		clocks = <&ethsys CLK_ETHSYS_HSDMA>;
		clock-names = "hsdma";
		status = "okay";
	};

DMA clients must use the format described in dma/dma.txt file.
```

## Documentation/devicetree/bindings/drm/mediatek/mediatek,hdmi.txt
```
Mediatek HDMI Encoder
=====================

The Mediatek HDMI encoder can generate HDMI 1.4a or MHL 2.0 signals from
its parallel input.

Required properties:
- compatible: Should be "mediatek,<chip>-hdmi".
- reg: Physical base address and length of the controller's registers
- reg-names: must contain "grl", "cec", and "sys".
- interrupts: The interrupt signal from the function block.
- clocks: device clocks
  See Documentation/devicetree/bindings/clock/clock-bindings.txt for details.
- clock-names: must contain "cec", "hdmi_sel", "hdmi_div1", "hdmi_div2",
  "hdmi_div3", "hdmi_pixel", "hdmi_pll", "aud_bclk", and "aud_spdif".
- ddc-i2c-bus: phandle link to the I2C controller used for DDC EDID probing
- phys: phandle link to the HDMI PHY node.
  See Documentation/devicetree/bindings/phy/phy-bindings.txt for details.
- phy-names: must contain "hdmi"
- ports: A node containing input and output port nodes with endpoint
  definitions as documented in Documentation/devicetree/bindings/graph.txt.
- port@0: The input port in the ports node should be connected to a DPI output
  port.

Optional properties:
- port@1: The output port in the ports node can be connected to the input port
  of an attached bridge chip, such as a SlimPort transmitter.

HDMI DDC
========

The HDMI DDC i2c controller is used to interface with the HDMI DDC pins.
The Mediatek's I2C controller is used to interface with I2C devices.

Required properties:
- compatible: Should be "mediatek,<chip>-hdmi-ddc"
- reg: Physical base address and length of the controller's registers
- clocks: device clock
- clock-names: Must contain "ddc-i2c".

HDMI PHY
========

The HDMI PHY serializes the HDMI encoder's three channel 10-bit parallel
output and drives the HDMI pads.

Required properties:
- compatible: "mediatek,<chip>-hdmi-phy"
- reg: Physical base address and length of the module's registers
- #phy-cells: must be <0>.

Optional properties:
- ibias: TX DRV bias current for <1.65Gbps, defaults to 0xa
- ibias_up: TX DRV bias current for >1.65Gbps, defaults to 0x1c

Example:

hdmi_phy: hdmi-phy@10209100 {
	compatible = "mediatek,mt8173-hdmi-phy";
	reg = <0 0x10209100 0 0x24>;
	ibias = <0xa>;
	ibias_up = <0x1c>;
	#phy-cells = <0>;
};

hdmi_ddc0: i2c@11012000 {
	compatible = "mediatek,mt8173-hdmi-ddc";
	reg = <0 0x11012000 0 0x1c>;
	interrupts = <GIC_SPI 81 IRQ_TYPE_LEVEL_LOW>;
	clocks = <&pericfg CLK_PERI_I2C5>;
};

hdmi0: hdmi@14025000 {
	compatible = "mediatek,mt8173-hdmi";
	reg = <0 0x14025000 0 0x400>,	/* GRL */
	      <0 0x10013000 0 0xbc>,	/* CEC */
	      <0 0x14000900 0 0x8>;	/* SYS */
	reg-names = "grl", "cec", "sys";
	interrupts = <GIC_SPI 167 IRQ_TYPE_LEVEL_LOW>;
	clocks = <&infracfg CLK_INFRA_CEC>,
		 <&topckgen CLK_TOP_HDMI_SEL>,
		 <&topckgen CLK_TOP_HDMITX_DIG_CTS>,
		 <&topckgen CLK_TOP_HDMITXPLL_D2>,
		 <&topckgen CLK_TOP_HDMITXPLL_D3>,
		 <&mmsys CLK_MM_HDMI_PIXEL>,
		 <&mmsys CLK_MM_HDMI_PLLCK>,
		 <&mmsys CLK_MM_HDMI_AUDIO>,
		 <&mmsys CLK_MM_HDMI_SPDIF>;
	clock-names = "cec",
		      "hdmi_sel",
		      "hdmi_div1",
		      "hdmi_div2",
		      "hdmi_div3",
		      "hdmi_pixel",
		      "hdmi_pll",
		      "aud_bclk",
		      "aud_spdif";
	ddc-i2c-bus = <&hdmi_ddc0>;
	pinctrl-names = "default";
	pinctrl-0 = <&hdmi_pin>;
	phys = <&hdmi_phy>;
	phy-names = "hdmi";
	status = "disabled";

	ports {
		#address-cells = <1>;
		#size-cells = <0>;

		port@0 {
			reg = <0>;

			hdmi0_in: endpoint {
				remote-endpoint = <&dpi0_out>;
			};
		};
	};
};
```

## Documentation/devicetree/bindings/input/mtk-pmic-keys.txt
```
MediaTek MT6397/MT6323 PMIC Keys Device Driver

There are two key functions provided by MT6397/MT6323 PMIC, pwrkey
and homekey. The key functions are defined as the subnode of the function
node provided by MT6397/MT6323 PMIC that is being defined as one kind
of Muti-Function Device (MFD)

For MT6397/MT6323 MFD bindings see:
Documentation/devicetree/bindings/mfd/mt6397.txt

Required properties:
- compatible: "mediatek,mt6397-keys" or "mediatek,mt6323-keys"
- mediatek,pwrkey-code: Keycode of pwrkey

Optional Properties:
- mediatek,homekey-code: Keycode of homekey
- mediatek,long-press-mode: Long press key shutdown setting, 1 for
	pwrkey only, 2 for pwrkey/homekey together, others for disabled.
- mediatek,long-press-duration: Long press key shutdown duration setting,
	0/1/2/3 for 8/11/14/5 seconds.

Example:

	pmic: mt6397 {
		compatible = "mediatek,mt6397";

		...

		mt6397keys: mt6397keys {
			compatible = "mediatek,mt6397-keys";
			mediatek,pwrkey-code = <116>;
			mediatek,homekey-code = <114>;
			mediatek,long-press-mode = <1>;
			mediatek,long-press-duration = <0>;
		};
	};
```

## Documentation/devicetree/bindings/mfd/mtk-audsys.txt
```
MediaTek Audio Subsystem Wrapper

Required properties:
- compatible: Should be "mediatek,mt2701-audsys-core".
- reg: Should contain the device's region location and size.
- clocks: Must contain an entry for each entry in clock-names.
  See ../clocks/clock-bindings.txt for details.
- clock-names: Should contain "infra_aud", "top_a1sys", "top_a2sys".

Required subnodes are described in:
- ../sound/mt2701-afe-pcm.txt.
- ../arm/mediatek/mediatek,audsys.txt.

Example:

	audio-subsystm@11220000 {
		compatible = "mediatek,mt2701-audsys-core";
		reg = <0 0x11220000 0 0x2000>,
		      <0 0x112a0000 0 0x20000>;
		clocks = <&infracfg CLK_INFRA_AUDIO>,
			 <&topckgen CLK_TOP_AUD_48K_TIMING>,
			 <&topckgen CLK_TOP_AUD_44K_TIMING>;
		clock-names = "infra_aud", "top_a1sys", "top_a2sys";

		audsys: clock {
			compatible = "mediatek,mt2701-audsys";
			#clock-cells = <1>;
		};

		afe: audio {
			compatible = "mediatek,mt2701-audio";
			interrupts =  <GIC_SPI 104 IRQ_TYPE_LEVEL_LOW>,
				      <GIC_SPI 132 IRQ_TYPE_LEVEL_LOW>;
			interrupt-names	= "afe", "asys";
			power-domains = <&scpsys MT2701_POWER_DOMAIN_IFR_MSC>;

			clocks = <&topckgen CLK_TOP_AUD_MUX1_SEL>,
				 <&topckgen CLK_TOP_AUD_MUX2_SEL>,
				 <&topckgen CLK_TOP_AUD_K1_SRC_SEL>,
				 <&topckgen CLK_TOP_AUD_K2_SRC_SEL>,
				 <&topckgen CLK_TOP_AUD_K3_SRC_SEL>,
				 <&topckgen CLK_TOP_AUD_K4_SRC_SEL>,
				 <&topckgen CLK_TOP_AUD_K1_SRC_DIV>,
				 <&topckgen CLK_TOP_AUD_K2_SRC_DIV>,
				 <&topckgen CLK_TOP_AUD_K3_SRC_DIV>,
				 <&topckgen CLK_TOP_AUD_K4_SRC_DIV>,
				 <&topckgen CLK_TOP_AUD_I2S1_MCLK>,
				 <&topckgen CLK_TOP_AUD_I2S2_MCLK>,
				 <&topckgen CLK_TOP_AUD_I2S3_MCLK>,
				 <&topckgen CLK_TOP_AUD_I2S4_MCLK>,
				 <&audsys CLK_AUD_I2SO1>,
				 <&audsys CLK_AUD_I2SO2>,
				 <&audsys CLK_AUD_I2SO3>,
				 <&audsys CLK_AUD_I2SO4>,
				 <&audsys CLK_AUD_I2SIN1>,
				 <&audsys CLK_AUD_I2SIN2>,
				 <&audsys CLK_AUD_I2SIN3>,
				 <&audsys CLK_AUD_I2SIN4>,
				 <&audsys CLK_AUD_ASRCO1>,
				 <&audsys CLK_AUD_ASRCO2>,
				 <&audsys CLK_AUD_ASRCO3>,
				 <&audsys CLK_AUD_ASRCO4>,
				 <&audsys CLK_AUD_AFE>,
				 <&audsys CLK_AUD_AFE_CONN>,
				 <&audsys CLK_AUD_A1SYS>,
				 <&audsys CLK_AUD_A2SYS>,
				 <&audsys CLK_AUD_AFE_MRGIF>;

			clock-names = "top_audio_mux1_sel",
				      "top_audio_mux2_sel",
				      "i2s0_src_sel",
				      "i2s1_src_sel",
				      "i2s2_src_sel",
				      "i2s3_src_sel",
				      "i2s0_src_div",
				      "i2s1_src_div",
				      "i2s2_src_div",
				      "i2s3_src_div",
				      "i2s0_mclk_en",
				      "i2s1_mclk_en",
				      "i2s2_mclk_en",
				      "i2s3_mclk_en",
				      "i2so0_hop_ck",
				      "i2so1_hop_ck",
				      "i2so2_hop_ck",
				      "i2so3_hop_ck",
				      "i2si0_hop_ck",
				      "i2si1_hop_ck",
				      "i2si2_hop_ck",
				      "i2si3_hop_ck",
				      "asrc0_out_ck",
				      "asrc1_out_ck",
				      "asrc2_out_ck",
				      "asrc3_out_ck",
				      "audio_afe_pd",
				      "audio_afe_conn_pd",
				      "audio_a1sys_pd",
				      "audio_a2sys_pd",
				      "audio_mrgif_pd";

			assigned-clocks = <&topckgen CLK_TOP_AUD_MUX1_SEL>,
					  <&topckgen CLK_TOP_AUD_MUX2_SEL>,
					  <&topckgen CLK_TOP_AUD_MUX1_DIV>,
					  <&topckgen CLK_TOP_AUD_MUX2_DIV>;
			assigned-clock-parents = <&topckgen CLK_TOP_AUD1PLL_98M>,
						 <&topckgen CLK_TOP_AUD2PLL_90M>;
			assigned-clock-rates = <0>, <0>, <49152000>, <45158400>;
		};
	};
```

## Documentation/devicetree/bindings/mtd/mtk_nor.txt
```
* MTD SPI nor driver for MTK MT81xx (and similar) serial flash controller

MTK MT81xx serial flash controller is designed for serial Flash device.
It supports one Flash device with signal mode, dual mode and quad mode.

Required properties:
- compatible: should be "mediatek,mt8173-nor";
- reg: physical base address and length of the controller's register
- clocks: spi nor source clock
- clock-names: "spi_clk", "axi_clk", "mux_clk", "sf_clk"

See Documentation/devicetree/bindings/clock/clock-bindings.txt
and Documentation/mtd/spi-nor.txt for details.

Example:
nor_flash: nor@1100d000 {
	compatible = "mediatek,mt8173-nor";
	reg = <0 0x1100d000 0 0xe0>;
	clocks = <&pericfg CLK_PERI_SPI>,
		 <&topckgen CLK_TOP_AXI_SEL>,
		 <&topckgen CLK_TOP_UNIVPLL2_D8>,
		 <&topckgen CLK_TOP_SPINFI_IFR_SEL>;
	clock-names = "spi_clk", "axi_clk", "mux_clk", "sf_clk";
};
```

## Documentation/devicetree/bindings/mtd/mtk_quadspi.txt
```
* MTD SPI nor driver for MTK MT81xx (and similar) serial flash controller

Required properties:
- compatible: Should be "mediatek,mt8173-nor";
- reg: Physical base address and length of the controller's register
- clocks: spi source clock amd serial flash controller's clock
- clock-names: "spi", "sf"
  See Documentation/devicetree/bindings/clock/clock-bindings.txt for details.

Example:
nor_flash: nor@1100d000 {
	compatible = "mediatek,mt8173-nor";
	reg = <0 0x1100D000 0 0xE0>;
	clocks = <&pericfg CLK_PERI_SPI>,
			 <&topckgen CLK_TOP_SPINFI_IFR_SEL>;
	clock-names = "spi", "sf";
};
```
